## Kconfig
```kconfig
# Sensor data simulator
#
# Copyright (c) 2019 Nordic Semiconductor
#
# SPDX-License-Identifier: LicenseRef-Nordic-5-Clause
#

menuconfig PMW3610_ALT
  bool "PMW3610 mouse optical sensor"
  select SPI
  depends on INPUT
  depends on DT_HAS_PIXART_PMW3610_ALT_ENABLED
  help
      Enable PMW3610 mouse optical sensor.

if PMW3610_ALT

config INPUT_PMW3610_INIT_PRIORITY
    int "PMW3610 initialization priority"
    default INPUT_INIT_PRIORITY

config PMW3610_ALT_SWAP_XY
  bool "Swap the X/Y axis of PMW3610 sensor (compile-time, hardware-level)"
  help
    Swap X and Y axes at the sensor hardware register level.
    Applied before the software rotation transform.
    For per-orientation adjustments, use the layer-based rotation feature instead.

config PMW3610_ALT_INVERT_X
  bool "Invert the X axis of PMW3610 sensor (software, after rotation)"
  help
    Invert the X axis in software AFTER the layer-based rotation transform is applied.
    Use this to correct the base axis orientation for your physical wiring.
    For hardware-level pre-rotation inversion, use the DTS 'invert-x' property instead.

config PMW3610_ALT_INVERT_Y
  bool "Invert the Y axis of PMW3610 sensor (software, after rotation)"
  help
    Invert the Y axis in software AFTER the layer-based rotation transform is applied.
    Use this to correct the base axis orientation for your physical wiring.
    For hardware-level pre-rotation inversion, use the DTS 'invert-y' property instead.

config PMW3610_ALT_INIT_POWER_UP_EXTRA_DELAY_MS
  int "Extra power up init delay (ms)"
  default 0
  help
    Default minimum init power up delay is 10ms.
    Use this config to postpone init power up sequence if needs longer bootup time.

config PMW3610_ALT_REPORT_INTERVAL_MIN
	int "PMW3610's default minimum report rate"
	default 0
	help
	  Default minimum report interval in milliseconds.
		Slow down input reporting for hid queue over the air.
		Turn value down to 8ms to get sharp response if use with USB only.

config PMW3610_ALT_SMART_ALGORITHM
  bool "Enable an algorithm of PMW3610 to enhance surface coverage"
  default y
  help
    Enable the integration of the smart algorithm as the datasheet implementation.
    The algorithm is used to extend the tracking acrocss a wider range of surfaces
    such as graniles and tiles.

config PMW3610_ALT_RUN_DOWNSHIFT_TIME_MS
    int "PMW3610's default RUN mode downshift time"
    default 128
    range 13 3264
    help
      Default RUN mode downshift down time in milliseconds.
      Time after which sensor goes from RUN to REST1 mode.

config PMW3610_ALT_REST1_DOWNSHIFT_TIME_MS
    int "PMW3610's default REST1 mode downshift time"
    default 5000
    help
      Default REST1 mode downshift down time in milliseconds.
      Time after which sensor goes from REST1 to REST2 mode.

config PMW3610_ALT_REST2_DOWNSHIFT_TIME_MS
    int "PMW3610's default REST2 mode downshift time"
    default 17000
    help
      Default REST2 mode downshift down time in milliseconds.
      Time after which sensor goes from REST2 to REST3 mode.

config PMW3610_ALT_REST1_SAMPLE_TIME_MS
    int "PMW3610's sample time in REST1 stage"
    default 40
    # range 10 2550
    help
      Default REST1 mode sample period in millisecond

config PMW3610_ALT_REST2_SAMPLE_TIME_MS
    int "PMW3610's sample time in REST2 stage"
    default 100
    # range 10 2550
    help
      Default REST2 mode sample period in millisecond.

config PMW3610_ALT_REST3_SAMPLE_TIME_MS
    int "PMW3610's sample time in REST3 stage"
    default 500
    # range 10 2550
    help
      Default REST2 mode sample period in millisecond.

config PMW3610_ALT_TRABO_SHIFT
    bool "Enable PMW3610 TraboShift"
    default n
    help
      Enable TraboShift: OctaShift by Tracking Ball.

config PMW3610_ALT_TRABO_SHIFT_SAMPLE_TIME_MS
    int "Sample time for TraboShift"
    default 100

config PMW3610_ALT_TRABO_SHIFT_DISTANCE_THRESHOLD
    int "Threshold of distance for TraboShift"
    default 1000

config PMW3610_ALT_TRABO_SHIFT_LAYER
    int "Layer to enable TraboShift"
    default 12

config PMW3610_ALT_TRABO_SHIFT_ANGLE
    int "Angle of each direction for TraboShift"
    default 45
    # range 3 45

config ZMK_BEHAVIOR_PMW3610_ROTATION
    bool "PMW3610 rotation behavior"
    default n
    depends on DT_HAS_ZMK_BEHAVIOR_PMW3610_ROTATION_ENABLED

module = PMW3610_ALT
module-str = PMW3610_ALT
source "${ZEPHYR_BASE}/subsys/logging/Kconfig.template.log_config"

endif #PMW3610_ALT
```

## dts/bindings/pixart,pmw3610-alt.yml
```yaml
description: |
  Sensor driver for the pixart PMW3610 mouse sensor

compatible: "pixart,pmw3610-alt"

include: spi-device.yaml

properties:
  irq-gpios:
    type: phandle-array
    required: true
  cpi:
    type: int
    default: 600
    description: "CPI value for normal (MOVE) mode (Range: 200 - 3200, Step: 200)"
  snipe-cpi:
    type: int
    default: 0
    description: |
      CPI value used when a snipe-layer is active (Range: 200 - 3200, Step: 200).
      Set to 0 to disable snipe mode CPI switching.
  swap-xy:
    type: boolean
    description: "Swap X/Y axes at sensor hardware level (applied before rotation transform)"
  invert-x:
    type: boolean
    description: "Invert X axis at sensor hardware level (applied before rotation transform)"
  invert-y:
    type: boolean
    description: "Invert Y axis at sensor hardware level (applied before rotation transform)"
  evt-type:
    type: int
    required: true
    description: "Input event type (e.g. INPUT_EV_REL)"
  x-input-code:
    type: int
    required: true
    description: "Input code for X axis (e.g. INPUT_REL_X)"
  y-input-code:
    type: int
    required: true
    description: "Input code for Y axis (e.g. INPUT_REL_Y)"
  force-awake:
    type: boolean
    description: "Keep sensor in high-performance mode while active"
  force-awake-4ms-mode:
    type: boolean
    description: "Use 4ms run rate when force-awake is enabled"
  scroll-layers:
    type: array
    default: []
    description: |
      List of keymap layer indices that activate SCROLL mode.
      When one of these layers is active, the orientation layer is not updated,
      so scrolling direction stays consistent with the last MOVE orientation.
      Actual scroll conversion is handled by the ZMK input-listener (zip_xy_to_scroll_mapper).
  snipe-layers:
    type: array
    default: []
    description: |
      List of keymap layer indices that activate SNIPE mode.
      When one of these layers is active, snipe-cpi is used instead of cpi,
      and the orientation layer is not updated.
  default-orientation-layer:
    type: int
    default: 0
    description: |
      Keymap layer index to use as the initial orientation at boot.
      Layer 0 = 0°, Layer 1 = 45°, Layer 2 = 90°, ..., Layer 7 = 315°.
      If > 0, that layer is activated in the keymap at initialization.
```

## west.yml
```yaml
manifest:
  remotes:
    - name: karbou12
      url-base: https://github.com/karbou12
  projects:
    - name: zmk-trackball-shift
      remote: karbou12
      revision: develop
```
